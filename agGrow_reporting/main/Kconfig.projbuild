## agGrow_reporting/main/Kconfig.projbuild
```kconfig
menu "Example Configuration"

    choice LCD_TYPE
        prompt "LCD module type"
        default LCD_TYPE_AUTO
        help
            The type of LCD on the evaluation board.

        config LCD_TYPE_AUTO
            bool "Auto detect"
        config LCD_TYPE_ST7789V
            bool "ST7789V (WROVER Kit v2 or v3)"
        config LCD_TYPE_ILI9341
            bool "ILI9341 (WROVER Kit v1 or DevKitJ v1)"
    endchoice

    config LCD_OVERCLOCK
        bool
        prompt "Run LCD at higher clock speed than allowed"
        default "n"
        help
            The ILI9341 and ST7789 specify that the maximum clock speed for the SPI interface is 10MHz. However,
            in practice the driver chips work fine with a higher clock rate, and using that gives a better framerate.
            Select this to try using the out-of-spec clock rate.

    config SET_RAW_ADV_DATA
        bool "Use raw data for advertising packets and scan response data"
        help
            If this config item is set, raw binary data will be used to generate advertising & scan response data.
            This option uses the esp_ble_gap_config_adv_data_raw() and esp_ble_gap_config_scan_rsp_data_raw()
            functions.

            If this config item is unset, advertising & scan response data is provided via a higher-level
            esp_ble_adv_data_t structure. The lower layer will generate the BLE packets. This option has higher
            overhead at runtime.
endmenu
```
